## config/west.yml
```yaml
manifest:
  remotes:
    - name: slightheadache
      url-base: https://github.com/SlightHeadache
  projects:
    - name: zmk
      remote: slightheadache
      revision: choctopus44
      import: app/west.yml
  self:
    path: config
```
